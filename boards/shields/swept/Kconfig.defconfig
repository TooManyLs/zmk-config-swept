## boards/shields/swept/Kconfig.defconfig
```kconfig
if SHIELD_SWEPT_DONGLE

config ZMK_KEYBOARD_NAME
    default "Swept"

config ZMK_SPLIT_ROLE_CENTRAL
    default y

config ZMK_SPLIT_BLE_CENTRAL_PERIPHERALS
    default 2

config ZMK_SLEEP
    default n

endif

if SHIELD_SWEPT_DONGLE || SHIELD_SWEPT_LEFT || SHIELD_SWEPT_RIGHT

config ZMK_SPLIT
    default y

endif

if SHIELD_SWEPT_LEFT || SHIELD_SWEPT_RIGHT

if ZMK_DISPLAY

config I2C
    default y

config SSD1306
    default y

endif # ZMK DISPLAY

endif
```

## boards/shields/swept/Kconfig.shield
```kconfig
config SHIELD_SWEPT_DONGLE
    def_bool $(shileds_list_contains, swept_dongle)

config SHIELD_SWEPT_LEFT
    def_bool $(shileds_list_contains, swept_left)

config SHIELD_SWEPT_RIGHT
    def_bool $(shileds_list_contains, swept_right)
```

## config/boards/shields/swept/Kconfig.defconfig
```kconfig
# Copyright (c) 2020 The ZMK Contributors
# SPDX-License-Identifier: MIT

if SHIELD_SWEPT_DONGLE

config ZMK_KEYBOARD_NAME
	default "Swept"
	
config ZMK_SPLIT_BLE_ROLE_CENTRAL
	default y
	
config ZMK_USB
	default y

endif

if SHIELD_SWEPT_LEFT || SHIELD_SWEPT_RIGHT || SHIELD_SWEPT_DONGLE 

config ZMK_SPLIT
	default y

config ZMK_BLE
	default y
	
endif

if SHIELD_SWEPT_LEFT || SHIELD_SWEPT_RIGHT

if ZMK_DISPLAY

config I2C
        default y

config SSD1306
        default y

endif # ZMK_DISPLAY

endif
```

## config/boards/shields/swept/Kconfig.shield
```kconfig
config SHIELD_SWEPT_CENTRAL_DONGLE
    def_bool $(shields_list_contains, swept_central_dongle)

config SHIELD_SWEPT_PERIPHERAL_LEFT
    def_bool $(shields_list_contains, swept_peripheral_left)

config SHIELD_SWEPT_PERIPHERAL_RIGHT
    def_bool $(shields_list_contains, swept_peripheral_right)
```
